## boards/shields/ulk/Kconfig.defconfig
```kconfig
config ZMK_KEYBOARD_NAME
    default "ulk"

config ZMK_SPLIT
    default y


CONFIG_USB=y
CONFIG_USB_DEVICE_STACK=y
CONFIG_USB_HID=y
CONFIG_ZMK_USB=y
CONFIG_ZMK_USB_BOOT=y
```
